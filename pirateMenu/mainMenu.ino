const byte choiceFighter[] PROGMEM = {88,48,0xFF,0xFF,0xFF,0xFF,0xFF,0xFF,0xFF,0xFF,0xFC,0x0,0x0,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0x0,};

#define NB_ITEMS_MENU 16
int8_t selectedItem = 0;



void initMenu()
{
   selectedItem = 0;
}

void updateMenu()
{
     if(gb.buttons.pressed(BTN_A)){
        //loadGame();
        writeData();
        stateGame = 1;
         
    }
    
    if(gb.buttons.pressed(BTN_RIGHT)){
        selectedItem++;
        if(selectedItem >=NB_ITEMS_MENU)
        {
          selectedItem = 0;
        }
    }
    if(gb.buttons.pressed(BTN_LEFT)){
        selectedItem--;
        if(selectedItem <0)
        {
          selectedItem = (NB_ITEMS_MENU - 1);
        }
    }
    
    if(gb.buttons.pressed(BTN_UP)){
        selectedItem-=5;
        if(selectedItem <0)
        {
          selectedItem = (NB_ITEMS_MENU + selectedItem) - 1;
        }
        Serial.print(selectedItem);
    }
    if(gb.buttons.pressed(BTN_DOWN)){
      if(selectedItem == 10){
        selectedItem = 0;
      }
      else {
        selectedItem+=5;
        if(selectedItem >=NB_ITEMS_MENU)
        {
          selectedItem = (selectedItem - NB_ITEMS_MENU)+1;
        }
    }
  }
}

void drawMenu()
{
  gb.display.drawBitmap(0,0,choiceFighter);
  
  if(gb.frameCount % 10 >4){
    gb.display.setColor(INVERT);
    if(selectedItem == (NB_ITEMS_MENU - 1)){
      gb.display.drawRect(70,16,14,16); 
    }
    else {
      gb.display.drawRect(0 + ((selectedItem * 14)%70),0+ (((int)selectedItem/5) * 16),14,16); 
    }
    gb.display.setColor(BLACK); 
  }
}

void writeData()
{
  //return;//FOR simbuino test
    byte numChar = selectedItem%2; //if the number is 0 this is the first Char selected, else is the second
  
   // open the file for write at end like the Native SD library
  myFile = sd.open(BASE_NAME, O_RDWR|O_CREAT|O_TRUNC);
  if (!myFile) {
    sd.errorHalt("opening test.txt for write failed");
    gb.popup(F("ERROR SD"),10);
  }
  myFile.print('1');//on viens du menu
  myFile.println(numChar);//on a choisi un perso
  myFile.close();
  
}




