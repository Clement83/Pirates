const byte pirate0[] PROGMEM = {32,28,0x0,0x1,0xE0,0x0,0x0,0x6,0x10,0x0,0x0,0xC,0x48,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0x0,};



void updatePrevi()
{
     if(gb.buttons.pressed(BTN_A)){
        loadGame();
    }
     else if(gb.buttons.pressed(BTN_B)){
        stateGame = 0;
    }
    
    
}

void drawPrevi()
{
 //affiche le player selectionner
 switch(selectedItem)
 {
   case 0 : 
    gb.display.drawBitmap(0,0,pirate0);
    gb.display.cursorY = 0;
    gb.display.cursorX = 33;
    gb.display.print(F("Haddoc,"));
    gb.display.cursorY = 6;
    gb.display.cursorX = 33;
    gb.display.print(F("Old friend"));
    gb.display.cursorY = 12;
    gb.display.cursorX = 33;
    gb.display.print(F("of Tintin"));
    
    gb.display.cursorY = 30;
    gb.display.cursorX = 0;
    gb.display.print(F("He fight for : \n   -save world\n   -a wiskey bottle"));
   break;  
 }
}


void loadGame()
{
  //

  gb.display.clear();
  gb.display.print(F("Swords of the Sea Wolves \n\35 Loading\n\nPrepare to FIGHT\n Don't turn OFF"));
  gb.display.update();
  
  
  //TODO a big switch with the good .HEX to load !
  load_game("GAME");
  
}
