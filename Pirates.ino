#include <SPI.h>
#include <Gamebuino.h>
Gamebuino gb;
#include <Wire.h>

const byte Sprites[] PROGMEM = {128,128,0x0,0xF,0x0,0x0,0x0,0xF0,0x0,0x0,0x0,0x0,0x0,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0x0,};
const byte SpritesMask[] PROGMEM = {128,128,0x0,0xF,0x0,0x0,0x0,0xF0,0x0,0x0,0x0,0x0,0x0,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0x0,};

const byte player_sprites[][4] PROGMEM = {
  {0,0,28,29}, 
  {29,0,29,27}
};


/* fake button for slave*/
boolean bt_up,bt_down,bt_left,bt_right,bt_a,bt_b;

struct sprite_data
{
  char x, y, destX, destY, w, h;
};

typedef struct {
  byte const * sprite1;
  byte const * sprite2;
}animSprite;

#define NB_STATE 11
#define NB_SPRITE_STATE 2
#define TIME_ATTACK 2
#define SPEED_RUN 3
#define GROUND_Y 47
#define TIME_DEF 2
#define NB_MOVE_SAVE 4
#define TIME_LIVE_AYOUKEN 15
#define VITT_AYOUKEN 3
#define DAMAGE_AYOUKEN 10
typedef struct {
  byte posX,posY,timeLive,dir;
  animSprite sprites;
}
Ayouken;

#define TIME_FALL  5
typedef struct {
  uint8_t currentState; // IDL : 0 ,run : 1, kick : 2, punchLeft : 3, punchRight : 4,  duck1 : 5, duck1Kick : 6,jump1 : 7,jumpKick1 : 8 , dead1 : 9 , 10 Fire
  uint8_t currentSprite;//sprite 1 or 2
  float posX,posY;
  float vx,vy;
  uint8_t height,width;
  uint8_t currentCharater;
  int8_t life;
  int8_t oldLife;
  int8_t cadance;//speed of change sprite
  int8_t damage; //damage current punch
  byte dir; //NOFLIP -> and FLIPH <-
  int8_t timeAttack,timeNextAttack;
  boolean isJump;
  byte cptVictory;
  byte isDef;
  //Ayouken ayouken;
  byte combo[NB_MOVE_SAVE];
  uint8_t timeFall;  
}
Figther;

Figther Player1 = {0,0,8,18,0,0,28,29,1,100,100,2,5,NOFLIP,4,8,false,0,0,0};
Figther Player2 = {0,0,8,19,0,0,29,27,0,100,100,2,5,FLIPH,4,8,false,0,0,0};

#define CPT_COMBAT_INIT 30
byte cptCombat = 0;
byte stateFight;

boolean isMaster;
boolean isOnePlayer;
boolean isPaused;
boolean disconnected;
boolean slave_updated = false;
byte xoffsetCptGras;
byte yoffsetTimeUp;
byte cptTechArena;

byte stateGame = 3; //3 main menu, 0 game , 1 multiplayer menu , 2 option , 4 final screen ..... 

void leftFigther(Figther * player);
void rightFigther(Figther * player);
void highFigther(Figther * player);
void bottomFigther(Figther * player);
void punchFigther(Figther * player);
void kickFigther(Figther * player);
void initPlayer(boolean isStartGame);
void moveIAPlayer(Figther * player,Figther * human);
void initSpritePlayer(Figther * player, uint8_t numero);
void drawBitmapMask(int8_t dst_x, int8_t dst_y, int8_t dst_w, int8_t dst_h, int src_x, int src_y, const uint8_t *bitmap, const uint8_t *mask);
void drawBitmapMask(int8_t dst_x, int8_t dst_y, int8_t dst_w, int8_t dst_h, int8_t src_x, int8_t src_y, const uint8_t *bitmap, const uint8_t *mask,uint8_t rotation, uint8_t flip);
void drawBitmapCustom(Figther * play, byte dst_x, byte dst_y, const uint8_t *bitmap, const uint8_t *mask,uint8_t rotation, uint8_t flip);

/***********************************************
************Multiplayer const ******************
************************************************/
#define SLAVE_PAUSED 1
#define I_AM_MASTER 2
#define GAME_STATE 3
#define STATE_FIGHT 4
#define CPT_TECH_ARENA 5

#define P1_X 10
#define P1_Y 11
#define P1_STATE 12
#define P1_CURRENT_SPRITE 13
#define P1_H 14
#define P1_W 15
#define P1_HP 16
#define P1_CPT_VICTORY 17
#define P1_DIR 18

#define P2_X 20
#define P2_Y 21
#define P2_STATE 22
#define P2_CURRENT_SPRITE 23
#define P2_H 24
#define P2_W 25
#define P2_HP 26
#define P2_CPT_VICTORY 27
#define P2_DIR 28

/*arene*/
#define X_OFFSET_CPT_GRAS 30
#define CPT_COMBAT 31
#define CPT_OFFFSET_TIME_UP 32

/*SLAVE*/
#define BT_UP 41
#define BT_DOWN 42
#define BT_LEFT 43
#define BT_RIGHT 44
#define BT_A 45
#define BT_B 46

/*Ayouken */
//posX,posY,timeLive,dir
#define P1_AY_POSX 51
#define P1_AY_POSY 52
#define P1_AY_TTL 53
#define P1_AY_DIR 54

#define P2_AY_POSX 61
#define P2_AY_POSY 62
#define P2_AY_TTL 63
#define P2_AY_DIR 64


#define SLAVE_DATA_BUFFER_LENGTH 12

void setup()
{
  gb.begin();
  goTitleScreen();
}
byte diffculty = 15;//incrase for dificulte IA
void initGame()
{
  gb.battery.show = false;
  gb.setFrameRate(41);
  stateGame = 3;
  isMaster = true; //TODO Multiplayer game 
  isOnePlayer = true; //TODO Multiplayer game 
  slave_updated = false;
  isPaused = false;
  disconnected = false;
  initMainMenu();
  initPlayer();
  initArena();
  initFinalScreen();
}

const char strMaster[] PROGMEM = "Host (master)";
const char strSlave[] PROGMEM = "Join (slave)";
const char* const multiPlayerMenu[2] PROGMEM = {
  strMaster,
  strSlave
};

void loop(){

 if(gb.update())
 {
    if(gb.buttons.pressed(BTN_C)){
      //initGame();
      goTitleScreen();
    }
    if(stateGame == 3)
    {
      updateMainMenu();
      drawMainMenu();
    }
    else if(stateGame == 4)
    {
      updateFinalScreen();
      drawFinalScreen();
      if(isMaster && !isOnePlayer)
      {
         updateMaster();
      }
    }
    else if(stateGame == 1)
    {
      //multiplayer menu
      switch(gb.menu(multiPlayerMenu, 2)){
        case 0: //Host      
          isPaused = false;
          disconnected = false;
          isMaster = true;
          isOnePlayer = false;
          stateGame = 0;
          break;
        case 1: //Join
          isPaused = false;
          disconnected = false;
          isMaster = false;
          isOnePlayer = false;
          stateGame = 0;
          break;
        default:
          stateGame = 3;
          break;
       }
    }
    else if(stateGame == 2)
    {
        moveIAPlayer(&Player2,&Player1);
        moveIAPlayer(&Player1,&Player2);
        updatePlayer();
        updateArena();
        drawArena();
        drawPlayer();
        credit();
    }
    else 
    {
      //gb.popup(F("Is not posed"),20);
      if(isMaster && !isOnePlayer)
      {
         updateMaster();
      }
      else if(!isMaster && !isOnePlayer)
      {
        updatePlayerSalve();
        updateSlave();
      }
      
      if(!isPaused || isOnePlayer || !isMaster)
      {
        if(isMaster || isOnePlayer)
        {
          updatePlayer();
          updateArena();
        }  
   
       if(isOnePlayer)
        {
            moveIAPlayer(&Player2,&Player1);
        }      
      }
      drawArena();
      drawPlayer();
      //gb.display.print(stateFight);
    }
 }
}


