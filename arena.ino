
const byte arene[] PROGMEM = {88,48,0x0,0x0,0x0,0x0,0x0,0x0,0x0,0x0,0x0,0x0,0x0,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0xF0,};

const byte cptBold1[] PROGMEM = {8,12,0x18,0x28,0x48,0xA8,0xE8,0xE8,0x28,0x28,0xEC,0x84,0xFC,0xFC,};
const byte cptBold2[] PROGMEM = {8,12,0xFC,0x84,0xF4,0xF4,0xF4,0x84,0xBC,0xBC,0xBC,0x84,0xFC,0xFC,};
const byte cptBold3[] PROGMEM = {8,12,0xFC,0x84,0xF4,0xF4,0xF4,0x84,0xF4,0xF4,0xF4,0x84,0xFC,0xFC,};
const byte fight[] PROGMEM = {32,12,0xFD,0xF7,0xEF,0xDF,0x85,0x14,0x2B,0x51,0xBD,0xB5,0xEB,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0xCE,};

const byte timeUp[] PROGMEM = {48,12,0xFB,0xEF,0xDF,0x80,0x7E,0xFC,0x8A,0x28,0x50,0x80,0x5A,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0xE0,};
const byte p1ko[] PROGMEM = {40,12,0xF0,0x30,0x7,0xEF,0xC0,0x88,0x50,0x5,0xA8,0x40,0xB4,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0xC0,};
const byte p2ko[] PROGMEM = {40,12,0xF1,0xF8,0x7,0xEF,0xC0,0x89,0x8,0x5,0xA8,0x40,0xB5,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0xC0,};

const byte barreHaut[] PROGMEM = {88,10,0x10,0x0,0x0,0x0,0x0,0x0,0x0,0x0,0x0,0x0,0x80,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0x80,};
const byte ileTresor[] PROGMEM = {88,48,0xFF,0xFF,0xFF,0xFF,0xFF,0xFF,0xFF,0xFF,0xFF,0xFF,0xF0,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0xF0,};


byte const * tabCpt[4]  = {fight,cptBold1,cptBold2,cptBold3}; 

void initArena()
{
 cptCombat = CPT_COMBAT_INIT;
 cptTechArena = 80;
 stateFight = 0;
 xoffsetCptGras = 0;
 yoffsetTimeUp = 0;
}

void updateArena()
{
  if(cptTechArena>0) cptTechArena--;
  if(stateFight == 0)
  {
    if(cptTechArena == 19)
    {
      xoffsetCptGras = 13;
    }
    else if(cptTechArena == 0)
    {
      stateFight = 1;
    }
  }
  if(stateFight == 1 && cptCombat == 0)
  {
    stateFight = 3;
    cptTechArena = 60;
  }
  
 
  if((Player1.life == 0 ||Player2.life == 0) && stateFight != 2)
  {
    stateFight = 2;
    cptTechArena = 60;
  }
  
  if(stateFight == 1)
  {  
    if(gb.frameCount%20 == 0) cptCombat--;
  }
  
  if(stateFight == 3 || stateFight == 2)
  {
    if(cptTechArena >= 30 )
    {
      yoffsetTimeUp = cptTechArena-30;
    }
    if(cptTechArena ==0 )
    {
      stateFight = 4;
    }
  }
}


void drawArena()
{
  
  //if(gb.frameCount%2 ==0){ gb.display.drawBitmap(0,0,ileTresor); };
  
  gb.display.setColor(GRAY);
  gb.display.drawBitmap(0,0,ileTresor);
  gb.display.setColor(BLACK);
  
  //return;
  //gb.display.drawBitmap(0,0,arene);
  switch(stateFight)
  {
    case 0 :
       //3, 2, 1 Fight! 

       gb.display.drawBitmap(39-xoffsetCptGras,18,tabCpt[((uint8_t)cptTechArena/20)]);

    break;
    case 1 :
       //Fight 

       //displayInt(cptCombat,38,1,2);
    break;
    case 2 :
       //Figther KO 
       if(Player1.life != Player2.life)
       {
         gb.display.drawBitmap(29,18 + yoffsetTimeUp,((Player1.life == 0)? p1ko : p2ko) );
       }
    break;
    case 3 :
       //Time UP 
       gb.display.drawBitmap(21,18 + yoffsetTimeUp,timeUp);
    break;
  }
  
  byte dizaine = cptCombat/10;
  byte unite =  cptCombat - (dizaine*10);
  
  gb.display.cursorX = 39;
  gb.display.cursorY = 1;
  gb.display.print(dizaine);
  gb.display.cursorX = 42;
  gb.display.print(unite);
  
  
  gb.display.drawBitmap(0,0,barreHaut);
}

void restartCombat()
{
  initPlayer(false);
  initArena();
}


