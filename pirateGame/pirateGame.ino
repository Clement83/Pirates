#define CHIP_SELECT 10

#include <SdFat.h>

#include <SPI.h>
#include <Gamebuino.h>
Gamebuino gb;

SdFat sd;
File myFile;


const byte SpritesP1[] PROGMEM = {160,71,0x0,0x0,0x0,0x0,0x0,0x0,0x0,0x0,0x0,0x0,0x0,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0x0,};
const byte SpritesP1Mask[] PROGMEM = {160,71,0x0,0x0,0x0,0x0,0x0,0x0,0x0,0x0,0x0,0x0,0x0,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0x0,};

const byte SpritesP2[] PROGMEM = {160,71,0x0,0x0,0x0,0x0,0x0,0x0,0x0,0x0,0x0,0x0,0x0,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0x0,};
const byte SpritesP2Mask[] PROGMEM = {160,71,0x0,0x0,0x0,0x0,0x0,0x0,0x0,0x0,0x0,0x0,0x0,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0x0,};


const byte player1_sprites[][4] PROGMEM = {
  {3,2,32,28}, //STATE 0 IDLE
  {37,1,31,29}, //STATE 0
  {73,2,31,28}, //STATE 1 RUN
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  {99,34,52,35} //STATE 3
};


const byte player2_sprites[][4] PROGMEM = {
  {3,2,32,28}, //STATE 0 IDLE
  {37,1,31,29}, //STATE 0
  {73,2,31,28}, //STATE 1 RUN
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  {99,34,52,35} //STATE 3
};

#define NB_STATE 11
#define NB_SPRITE_STATE 2
#define TIME_ATTACK 6
#define SPEED_RUN 3
#define GROUND_Y 47
#define TIME_DEF 2
#define NB_MOVE_SAVE 4
#define TIME_FALL  5


int8_t selectedCharacter;

typedef struct {
  uint8_t currentState; // IDL : 0 ,run : 1, jump : 2, punchLeft : 3
  uint8_t currentSprite;//sprite 1 or 2
  float posX,posY;
  float vx,vy;
  //uint8_t height,width;
  uint8_t currentCharater;
  int8_t life;
  int8_t oldLife;
  int8_t cadance;//speed of change sprite
  int8_t damage; //damage current punch
  byte dir; //NOFLIP -> and FLIPH <-
  int8_t timeAttack,timeNextAttack;
  boolean isJump;
  byte cptVictory;
  byte isDef;
  //Ayouken ayouken;
  byte combo[NB_MOVE_SAVE];
  uint8_t timeFall;  
}
Figther;

Figther Player1 = {0,0,8,18,0,0,0,100,100,2,5,NOFLIP,4,8,false,0,0,0};
Figther Player2 = {0,0,8,19,0,0,0,100,100,2,5,FLIPH,4,8,false,0,0,0};

byte xoffsetCptGras;
byte yoffsetTimeUp;
byte cptTechArena;


byte stateGame = 3; //3 main menu, 0 game , 1 multiplayer menu , 2 option , 4 final screen ..... 

void leftFigther(Figther * player);
void rightFigther(Figther * player);
void highFigther(Figther * player);
void bottomFigther(Figther * player);
void punchFigther(Figther * player);
void kickFigther(Figther * player);
void initPlayer(boolean isStartGame);
void moveIAPlayer(Figther * player,Figther * human);
void initSpritePlayer(Figther * player, uint8_t numero);


void drawBitmapMask(int8_t dst_x, int8_t dst_y, int8_t dst_w, int8_t dst_h, int src_x, int src_y, const uint8_t *bitmap, const uint8_t *mask);
void drawBitmapMask(int8_t dst_x, int8_t dst_y, int8_t dst_w, int8_t dst_h, int8_t src_x, int8_t src_y, const uint8_t *bitmap, const uint8_t *mask,uint8_t rotation, uint8_t flip);
void drawBitmapCustom(byte state,byte sprite, byte dst_x, byte dst_y,uint8_t rotation, uint8_t flip,byte numP);
const byte* getSpriteSheetPlayer(byte numPlayer, boolean mask);





void setup()
{
  gb.begin();
  initSD();
  checkDataFile();
}


void loop(){

 if(gb.update())
 {
   //gb.display.print("The game");
    if(gb.buttons.pressed(BTN_C)){
     //go to game
      goTitleScreen();
    }
    
    //3 states combat, pause, final screen
    switch(stateGame)
    {
      case 0 :
        updatePlayer();
        updateArena();
        moveIAPlayer(&Player2,&Player1);      
        
        drawArena();
        drawPlayer(); 
      break;  
      case 1 : 
      break;  
      
    }
  } 
}

void returnToMenu()
{
  gb.display.clear();
  gb.display.print(F("Swords of the Sea Wolves \n\35 Flashing\n  menu...\n\nDON'T TURN OFF!"));
  gb.display.update();
  load_game("PIRATES");
}

#define BASE_NAME "PIRATE.JC"

void initSD()
{
  if (!sd.begin(CHIP_SELECT)) {
    Serial.println(F("begin error"));
    gb.popup(F("ERROR SD"),10);
    //return;
  }
}

void checkDataFile()
{
  selectedCharacter = 0;//ONLY for simbuino test
  return;//ONLY for simbuino test
  //O_RDONLY
  myFile = sd.open(BASE_NAME, O_RDONLY);
  if (!myFile) {
    Serial.println(F("open error"));
    gb.popup(F("ERROR SD"),10);
    //return;
  }
  int i = myFile.parseInt();
  
  myFile.close();  
  if(i < 10) 
  {
    //TODO return to menu
    //myFile.close();
    gb.popup(F("return to menu"),10);
    returnToMenu();
  }
  else {
    gb.popup(F("Go to fight"),10);
  }
  
  myFile = sd.open(BASE_NAME, O_RDWR|O_CREAT|O_TRUNC);
  myFile.println("0");
  myFile.close();  
  
  selectedCharacter = i-10;
}

